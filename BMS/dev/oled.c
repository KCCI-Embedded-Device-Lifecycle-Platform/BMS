/**
 * @file    oled.c
 * @brief   SSD1306 128x64 OLED 드라이버 (프레임버퍼 방식, I2C)
 *
 * GDDRAM 은 128x64 를 8개 "페이지" 로 나눈다. 한 바이트가 세로 8픽셀(LSB 가 위)을 담당하므로
 * 프레임버퍼는 128 x 8 = 1024 byte. F446RE(SRAM 128KB)에 부담이 없고, 직접 그리기보다
 * I2C 트래픽이 적으며 화면 깜빡임(tearing)이 없다.
 *
 * @note  I2C 전용이다 ([제어바이트][페이로드] 한 트랜잭션, 주소 0x3C, 모듈에 따라 0x3D).
 *        SPI 경로는 삭제했다 — 최종 부품(ELB200168)이 I2C 4핀 전용이라 .ioc 에서 SPI2 를
 *        내렸고, HAL_SPI_MODULE_ENABLED 조차 꺼져 코드만 복원하면 빌드가 깨진다.
 *        I2C3 전용 버스라 팩 센서 I2C1을 막지는 않지만 flush 약 23ms 동안
 *        super-loop가 블로킹되므로 OLED는 500ms 슬롯 전용이다.
 *        화면이 좌우로 2픽셀 밀려 보이면 SH1106 이므로 CFG_OLED_COL_OFFSET 을 2 로 바꾼다.
 */
#include "oled.h"
#include "dbg.h"
#include "hw_i2c.h"

#define OLED_PAGES          (CFG_OLED_HEIGHT / 8U)
#define OLED_FB_SIZE        (CFG_OLED_WIDTH * OLED_PAGES)
#define OLED_CTRL_CMD       0x00U
#define OLED_CTRL_DATA      0x40U
#define OLED_FONT_W         6U      /* 5px 글리프 + 1px 간격 */

/* 버스 글리치로 죽었을 때 재초기화를 몇 번까지 시도할지.
 * 무제한으로 두면 안 된다 — 버스가 진짜 죽어 있으면 재시도 1회가
 * 커맨드 25개 x 타임아웃이라 500ms 슬롯이 통째로 블로킹되고, 100ms 슬롯의
 * "Fault 후 100ms 내 permit=0" 이 무너진다. 20회(약 10초) 뒤 포기한다. */
#define OLED_REINIT_MAX     20U

static uint8_t s_fb[OLED_FB_SIZE];
static bool    s_ok;
static uint8_t s_reinit_cnt;

/* --- 5x7 ASCII 폰트 (0x20 ~ 0x7E), 세로 비트, LSB=위 --- */
static const uint8_t s_font5x7[][5] = {
    {0x00,0x00,0x00,0x00,0x00}, {0x00,0x00,0x5F,0x00,0x00}, {0x00,0x07,0x00,0x07,0x00},
    {0x14,0x7F,0x14,0x7F,0x14}, {0x24,0x2A,0x7F,0x2A,0x12}, {0x23,0x13,0x08,0x64,0x62},
    {0x36,0x49,0x55,0x22,0x50}, {0x00,0x05,0x03,0x00,0x00}, {0x00,0x1C,0x22,0x41,0x00},
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    {0x00,0x41,0x36,0x08,0x00}, {0x08,0x08,0x2A,0x1C,0x08}
};

/* --- 초기화 커맨드 시퀀스 (데이터시트 권장 순서) --- */
static const uint8_t s_init_cmd[] = {
    0xAE,               /* Display OFF                       */
    0x20, 0x00,         /* Memory Addressing Mode = Horizontal*/
    0xB0,               /* Page start                        */
    0xC8,               /* COM scan direction 재매핑          */
    0x00, 0x10,         /* Column addr low/high              */
    0x40,               /* Start line = 0                    */
    0x81, CFG_OLED_CONTRAST,  /* Contrast (기본 0x7F 는 외부 Vcc 기준 - 흐리다) */
    0xA1,               /* Segment re-map                    */
    0xA6,               /* Normal display (A7 = 반전)         */
    0xA8, 0x3F,         /* Multiplex ratio = 64              */
    0xA4,               /* RAM 내용 출력                      */
    0xD3, 0x00,         /* Display offset = 0                */
    0xD5, 0x80,         /* Clock divide / osc freq           */
    0xD9, 0xF1,         /* Pre-charge period                 */
    0xDA, 0x12,         /* COM pins config (128x64 = 0x12)   */
    0xDB, 0x40,         /* VCOMH deselect level              */
    0x8D, 0x14,         /* Charge pump ON  (이거 빠지면 화면 안 켜짐) */
    0xAF                /* Display ON                        */
};

/* ------------------------------------------------------------------
 *  전송 계층 : 여기만 버스에 의존한다.
 * ------------------------------------------------------------------ */
static bool oled_tx(bool is_data, const uint8_t *p_data, uint16_t len)
{
    uint8_t tx[CFG_OLED_WIDTH + 1U];

    if (len > CFG_OLED_WIDTH) {
        return false;
    }
    tx[0] = is_data ? OLED_CTRL_DATA : OLED_CTRL_CMD;
    memcpy(&tx[1], p_data, len);
    return hw_i2c_write(HW_I2C_OLED, CFG_OLED_I2C_ADDR, tx, (uint16_t)(len + 1U));
}

static bool oled_bus_setup(void)
{
    if (!hw_i2c_is_ready(HW_I2C_OLED, CFG_OLED_I2C_ADDR)) {
        DBG_E("OLED no ACK at 0x%02X (try 0x3D)", CFG_OLED_I2C_ADDR);
        return false;
    }
    return true;
}

static bool oled_cmd(uint8_t c)
{
    return oled_tx(false, &c, 1U);
}

/** @brief 커맨드 시퀀스만 전송 (clear/flush 없음) — init 과 재초기화가 공유한다 */
static bool oled_send_init_seq(void)
{
    uint16_t i;

    for (i = 0; i < sizeof(s_init_cmd); i++) {
        if (!oled_cmd(s_init_cmd[i])) {
            DBG_E("OLED init cmd[%u] fail", i);
            return false;
        }
    }
    return true;
}

bool oled_init(void)
{
    s_ok         = false;
    s_reinit_cnt = 0U;

    if (!oled_bus_setup()) {
        return false;
    }

    if (!oled_send_init_seq()) {
        return false;
    }

    s_ok = true;
    oled_clear();
    oled_flush();
    DBG_I("OLED ok (SSD1306 128x64, I2C3 @0x%02X)", CFG_OLED_I2C_ADDR);
    return true;
}

void oled_clear(void)
{
    memset(s_fb, 0x00, sizeof(s_fb));
}

void oled_flush(void)
{
    uint8_t page;

    /* 전송 실패 한 번으로 화면이 리셋까지 영구히 죽는 것을 막는다.
     * s_ok=false 로만 두면 "OLED flush fail" 한 줄 뒤 화면이 마지막 프레임에 얼어붙어,
     * 값이 갱신되지 않는 것을 표시 버그로 오인하게 된다 (실제 원인은 I2C 버스다).
     * 프레임버퍼는 살아 있으므로 커맨드 시퀀스만 다시 태우면 그대로 복귀한다. */
    if (!s_ok) {
        if (s_reinit_cnt >= OLED_REINIT_MAX) {
            return;                 /* 포기 (아래 경고를 이미 냈다) */
        }
        s_reinit_cnt++;
        if (!oled_send_init_seq()) {
            if (s_reinit_cnt == OLED_REINIT_MAX) {
                DBG_E("OLED 재초기화 %u회 실패 - 포기. I2C 배선/풀업을 볼 것 ('b' 로 재시도)",
                      s_reinit_cnt);
            }
            return;
        }
        s_ok = true;
        DBG_W("OLED re-init ok (%u회째) - I2C 버스가 불안정하다", s_reinit_cnt);
    }

    for (page = 0; page < OLED_PAGES; page++) {
        /* 페이지 시작 위치 지정 (컬럼 오프셋은 SH1106 대응) */
        (void)oled_cmd((uint8_t)(0xB0U + page));
        (void)oled_cmd((uint8_t)(0x00U | (CFG_OLED_COL_OFFSET & 0x0FU)));
        (void)oled_cmd((uint8_t)(0x10U | ((CFG_OLED_COL_OFFSET >> 4) & 0x0FU)));

        if (!oled_tx(true, &s_fb[page * CFG_OLED_WIDTH], CFG_OLED_WIDTH)) {
            s_ok = false;
            DBG_E("OLED flush fail (page %u)", page);
            return;
        }
    }
}

void oled_draw_char(uint8_t x, uint8_t page, char c)
{
    uint8_t i;
    uint8_t idx;

    if ((page >= OLED_PAGES) || (x + OLED_FONT_W > CFG_OLED_WIDTH)) {
        return;
    }
    if ((c < 0x20) || (c > 0x7E)) {
        c = ' ';
    }
    idx = (uint8_t)(c - 0x20);

    for (i = 0; i < 5U; i++) {
        s_fb[(page * CFG_OLED_WIDTH) + x + i] = s_font5x7[idx][i];
    }
    s_fb[(page * CFG_OLED_WIDTH) + x + 5U] = 0x00;      /* 자간 */
}

void oled_draw_str(uint8_t x, uint8_t page, const char *s)
{
    while ((*s != '\0') && ((x + OLED_FONT_W) <= CFG_OLED_WIDTH)) {
        oled_draw_char(x, page, *s++);
        x = (uint8_t)(x + OLED_FONT_W);
    }
}

void oled_printf(uint8_t x, uint8_t page, const char *fmt, ...)
{
    char    buf[24];
    va_list ap;

    va_start(ap, fmt);
    (void)vsnprintf(buf, sizeof(buf), fmt, ap);
    va_end(ap);

    oled_draw_str(x, page, buf);
}

bool oled_is_ok(void)
{
    return s_ok;
}
